## firmware/platforms/esp32/smart-switch-app/main/Kconfig.projbuild
```kconfig
menu "EH Home Product Variant Configuration"

    config EH_PRODUCT_TYPE
        string "Product Type (SMART_SWITCH or SMART_SOCKET)"
        default "SMART_SWITCH"
        help
            Product category classification: SMART_SWITCH or SMART_SOCKET.

    config EH_CHANNEL_COUNT
        int "Relay and Physical Switch Channel Count (1 to 4)"
        range 1 4
        default 4
        help
            Active channel count for this product variant (1X=1, 2X=2, 3X=3, 4X=4).
            Channels above this count will remain unconfigured with zero pin allocation.

    config EH_PRODUCT_VARIANT
        string "Variant Identifier (1X, 2X, 3X, 4X)"
        default "4X"
        help
            Marketing/technical variant identifier string.

    config EH_MODEL_NAME
        string "Model Name (e.g. EH-SW-4X, EH-SK-2X)"
        default ""
        help
            Deterministic hardware model string. Leave empty for automatic derivation.

    config EH_FIRMWARE_FAMILY
        string "Canonical Firmware Family"
        default "esp32c6-switch-platform"
        help
            Canonical platform lineage: esp32c6-switch-platform or esp32c6-socket-platform.

    config EH_ENERGY_METERING_ENABLED
        bool "Enable BL0942 Energy Metering Telemetry"
        default n
        help
            Enable UART BL0942 energy metering telemetry driver (EM model variant).

endmenu
```

## firmware/platforms/esp32/smart-switch-app/sdkconfig.defaults
```kconfig
# Partition Table
CONFIG_PARTITION_TABLE_CUSTOM=y
CONFIG_PARTITION_TABLE_CUSTOM_FILENAME="partitions.csv"
CONFIG_PARTITION_TABLE_FILENAME="partitions.csv"
CONFIG_PARTITION_TABLE_OFFSET=0x8000
CONFIG_ESPTOOLPY_FLASHSIZE_4MB=y
CONFIG_ESPTOOLPY_FLASHSIZE="4MB"

# FreeRTOS & System
CONFIG_FREERTOS_HZ=1000
CONFIG_ESP_SYSTEM_EVENT_TASK_STACK_SIZE=3072
CONFIG_ESP_MAIN_TASK_STACK_SIZE=4096
CONFIG_ESP_TASK_WDT_TIMEOUT_S=10

# Bluetooth / NimBLE (Low-memory footprint)
CONFIG_BT_ENABLED=y
CONFIG_BT_BLE_ENABLED=y
CONFIG_BT_BLUEDROID_ENABLED=n
CONFIG_BT_NIMBLE_ENABLED=y
CONFIG_BT_NIMBLE_MAX_CONNECTIONS=1
CONFIG_BT_NIMBLE_MAX_BONDS=1
CONFIG_BT_NIMBLE_MAX_CCCDS=4
CONFIG_BT_NIMBLE_ATT_PREFERRED_MTU=256

# mbedTLS Memory Optimization (No PSRAM)
CONFIG_MBEDTLS_HKDF_C=y
CONFIG_MBEDTLS_GCM_C=y
CONFIG_MBEDTLS_DYNAMIC_BUFFER=y
CONFIG_MBEDTLS_DYNAMIC_FREE_PEER_CERT=y
CONFIG_MBEDTLS_DYNAMIC_FREE_CONFIG_DATA=y
CONFIG_MBEDTLS_SSL_IN_CONTENT_LEN=4096
CONFIG_MBEDTLS_SSL_OUT_CONTENT_LEN=4096
CONFIG_MBEDTLS_CERTIFICATE_BUNDLE=n

# MQTT Client
CONFIG_MQTT_TRANSPORT_SSL=y
CONFIG_MQTT_TRANSPORT_WEBSOCKET=n
CONFIG_MQTT_USE_CUSTOM_CONFIG=y

# OTA & Security
CONFIG_BOOTLOADER_APP_ROLLBACK_ENABLE=y
CONFIG_APP_ROLLBACK_ENABLE=y
CONFIG_SECURE_ENABLE_SECURE_BOOT=n
CONFIG_SECURE_FLASH_ENC_ENABLED=n

# IRAM Optimizations (Wi-Fi + BLE on ESP32)
CONFIG_ESP_WIFI_IRAM_OPT=n
CONFIG_ESP_WIFI_RX_IRAM_OPT=n
CONFIG_ESP32_WIFI_IRAM_OPT=n
CONFIG_ESP32_WIFI_RX_IRAM_OPT=n
CONFIG_ESP_EVENT_POST_FROM_IRAM_ISR=n
CONFIG_POST_EVENTS_FROM_IRAM_ISR=n
CONFIG_GPTIMER_ISR_HANDLER_IN_IRAM=n
CONFIG_SPI_MASTER_ISR_IN_IRAM=n
CONFIG_SPI_SLAVE_ISR_IN_IRAM=n
CONFIG_HAL_SPI_MASTER_FUNC_IN_IRAM=n
CONFIG_HAL_SPI_SLAVE_FUNC_IN_IRAM=n
CONFIG_PERIPH_CTRL_FUNC_IN_IRAM=n
CONFIG_ESP_SPI_BUS_LOCK_ISR_FUNCS_IN_IRAM=n
CONFIG_COMPILER_OPTIMIZATION_SIZE=y
```
